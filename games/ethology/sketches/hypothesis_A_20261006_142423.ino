/*
  hypothesis_A_20261006_142423.ino
  Generated by PAW Hierarchy Builder — 2026-10-06 14:24
  Board/shield: Uno R4 WiFi — Prototype (bare Arduino)

  Hierarchy (highest priority first):
    1. Escape Front
    2. Escape Back
    3. Avoid Object
    4. Avoid Light
    5. Cruise Straight

  Architecture mirrors the physical robot:
    - EthologyRobot provides individual behaviour methods
    - hierarchy() chains them in priority order
    - loop() calls hierarchy() each tick
*/

#include <Servo.h>
#include "CogServo.h"
#include "EthologyRobot.h"


EthologyRobot bot;

void hierarchy() {
  if (bot.collisionThreshold()) {  // Escape Front
    bot.escapeFrontCollision();
  }
  else if (bot.backCollisionThreshold()) {  // Escape Back
    bot.escapeBackCollision();
  }
  else if (bot.proximityThreshold()) {  // Avoid Object
    bot.avoidObject();
  }
  else if (bot.lightGradientThreshold()) {  // Avoid Light
    bot.avoidLight();
  }
  else {  // Cruise Straight
    bot.cruiseStraight();
  }
}

void setup() {
  Serial.begin(9600);
  
  bot.begin(6, 5);

  // cruise_arc picks a direction with random() and holds it. Without
  // a seed every power cycle replays the same sequence of turns, so
  // two robots side by side would arc identically.
  randomSeed(analogRead(A5));
}

void loop() {
  // Sense first. readSensors() halts the motors and samples every
  // sensor once, so all guards below see the same reading and a tick
  // where nothing fires leaves the robot stopped.
  bot.readSensors();
  hierarchy();
}
