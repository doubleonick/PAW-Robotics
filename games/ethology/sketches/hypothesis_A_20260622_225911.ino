/*
  hypothesis_A_20260622_225911.ino
  Generated by PAW Hierarchy Builder � 2026-06-22 22:59
  Board/shield: Uno R4 WiFi — Prototype (bare Arduino)

  Hierarchy (highest priority first):
    1. Escape Front
    2. Avoid Object
    3. Seek Light
    4. Cruise Straight

  Architecture mirrors the physical robot:
    - EthologyRobot provides individual behaviour methods
    - hierarchy() chains them in priority order
    - loop() calls hierarchy() each tick
*/

#include <Servo.h>
#include "CogServo.h"
#include "EthologyRobot.h"

CogServo driveServos;
EthologyRobot bot(driveServos);

void hierarchy() {
  if (bot.front_contact_met()) {  // Escape Front
    bot.escape_front();
  }
  else if (bot.proximity_threshold_met()) {  // Avoid Object
    bot.avoid_object();
  }
  else if (bot.light_gradient_met()) {  // Seek Light
    bot.seek_light();
  }
  else {  // Cruise Straight
    bot.cruise_straight();
  }
}

void setup() {
  Serial.begin(9600);
  driveServos.begin(6, 5);
  bot.begin();
}

void loop() {
  hierarchy();
}
